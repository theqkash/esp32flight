## main/Kconfig.projbuild
```kconfig
menu "Example Configuration"

    menu "Display"
        config EXAMPLE_LCD_RGB_BOUNCE_BUFFER_HEIGHT
            int "RGB Bounce buffer height"
            default 10
            help
                Height of bounce buffer. The width of the buffer is the same as that of the LCD.

        config EXAMPLE_LVGL_PORT_TASK_MAX_DELAY_MS
            int "LVGL timer task maximum delay (ms)"
            default 500
            range 2 2000  # Example range, adjust as needed
            help
            The maximum delay of the LVGL timer task, in milliseconds.

        config EXAMPLE_LVGL_PORT_TASK_MIN_DELAY_MS
            int "LVGL timer task minimum delay (ms)"
            default 10
            range 1 100  # Example range, adjust as needed
            help
            The minimum delay of the LVGL timer task, in milliseconds.

        config EXAMPLE_LVGL_PORT_TASK_PRIORITY
            int "LVGL task priority"
            default 2
            help
                The Board Support Package will create a task that will periodically handle LVGL operation in lv_timer_handler().

        config EXAMPLE_LVGL_PORT_TASK_STACK_SIZE_KB
            int "LVGL task stack size (KB)"
            default 6
            help
                Size(KB) of LVGL task stack.

        config EXAMPLE_LVGL_PORT_TASK_CORE
            int "LVGL timer task core"
            default -1
            range -1 1
            help
            The core of the LVGL timer task.
            Set to -1 to not specify the core.
            Set to 1 only if the SoCs support dual-core, otherwise set to -1 or 0.

        config EXAMPLE_LVGL_PORT_TICK
            int "LVGL tick period"
            default 2
            range 1 100
            help
                Period of LVGL tick timer.

        config EXAMPLE_LVGL_PORT_AVOID_TEAR_ENABLE
            bool "Avoid tearing effect"
            default "n"
            help
                Avoid tearing effect through LVGL buffer mode and double frame buffers of RGB LCD. This feature is only available for RGB LCD.

        choice
            depends on EXAMPLE_LVGL_PORT_AVOID_TEAR_ENABLE
            prompt "Select Avoid Tearing Mode"
            default EXAMPLE_LVGL_PORT_AVOID_TEAR_MODE_3
            config EXAMPLE_LVGL_PORT_AVOID_TEAR_MODE_1
                bool "Mode1: LCD double-buffer & LVGL full-refresh"
            config EXAMPLE_LVGL_PORT_AVOID_TEAR_MODE_2
                bool "Mode2: LCD triple-buffer & LVGL full-refresh"
            config EXAMPLE_LVGL_PORT_AVOID_TEAR_MODE_3
                bool "Mode3: LCD double-buffer & LVGL direct-mode"
            help
                The current tearing prevention mode supports both full refresh mode and direct mode. Tearing prevention mode may consume more PSRAM space
        endchoice

        config EXAMPLE_LVGL_PORT_AVOID_TEAR_MODE
            depends on EXAMPLE_LVGL_PORT_AVOID_TEAR_ENABLE
            int
            default 1 if EXAMPLE_LVGL_PORT_AVOID_TEAR_MODE_1
            default 2 if EXAMPLE_LVGL_PORT_AVOID_TEAR_MODE_2
            default 3 if EXAMPLE_LVGL_PORT_AVOID_TEAR_MODE_3

        choice
            depends on EXAMPLE_LVGL_PORT_AVOID_TEAR_ENABLE
            prompt "Select rotation"
            default EXAMPLE_LVGL_PORT_ROTATION_0
            config EXAMPLE_LVGL_PORT_ROTATION_0
                bool "Rotation 0"
            config EXAMPLE_LVGL_PORT_ROTATION_90
                bool "Rotation 90"
            config EXAMPLE_LVGL_PORT_ROTATION_180
                bool "Rotation 180"
            config EXAMPLE_LVGL_PORT_ROTATION_270
                bool "Rotation 270"
        endchoice

        config EXAMPLE_LVGL_PORT_ROTATION_DEGREE
            int
            default 0 if EXAMPLE_LVGL_PORT_ROTATION_0
            default 90 if EXAMPLE_LVGL_PORT_ROTATION_90
            default 180 if EXAMPLE_LVGL_PORT_ROTATION_180
            default 270 if EXAMPLE_LVGL_PORT_ROTATION_270

        choice
            depends on !EXAMPLE_LVGL_PORT_AVOID_TEAR_ENABLE
            prompt "Select LVGL buffer memory capability"
            default EXAMPLE_LVGL_PORT_BUF_INTERNAL
            config EXAMPLE_LVGL_PORT_BUF_PSRAM
                bool "PSRAM memory"
            config EXAMPLE_LVGL_PORT_BUF_INTERNAL
                bool "Internal memory"
        endchoice

        config EXAMPLE_LVGL_PORT_BUF_HEIGHT
            depends on !EXAMPLE_LVGL_PORT_AVOID_TEAR_ENABLE
            int "LVGL buffer height"
            default 100
            help
                Height of LVGL buffer. The width of the buffer is the same as that of the LCD.
    endmenu

    menu "CanFlight"
        choice CANFLIGHT_BOARD
            prompt "Display board"
            default CANFLIGHT_BOARD_AUTO
            help
                All supported boards are ESP32-S3 with a 800x480 RGB565
                panel and GT911 touch; they differ in pin mapping, backlight
                control and touch orientation. Auto probes the Waveshare
                CH422G IO expander on I2C at boot and picks the right pin
                set - one binary serves all of them (web flasher and OTA
                stay single-artifact). The whole Waveshare 800x480 family
                (4.3", 5", 7") shares one pinout, so it needs no telling
                apart. Force a board only if a clone confuses the probe.

            config CANFLIGHT_BOARD_AUTO
                bool "Auto-detect (Waveshare 4.3/5/7 / Guition JC8048W550)"

            config CANFLIGHT_BOARD_WAVESHARE_7
                bool "Force Waveshare ESP32-S3-Touch-LCD (4.3/5/7 inch)"

            config CANFLIGHT_BOARD_GUITION_JC8048W550
                bool "Force Guition JC8048W550 (5 inch)"

            config CANFLIGHT_BOARD_WAVESHARE_7B
                bool "Waveshare ESP32-S3-Touch-LCD-7B (1024x600)"
                help
                    The type-B 7 inch board: 1024x600 panel, CH32V003
                    helper MCU instead of the CH422G (same I2C address
                    0x24, different protocol, real brightness PWM).
                    The resolution differs, so this is a dedicated
                    build, not part of the auto-detected binary.

            config CANFLIGHT_BOARD_CROWPANEL_70
                bool "Elecrow CrowPanel 7.0 (DIS08070H, 800x480, 4 MB flash)"
                help
                    The 7 inch CrowPanel and its unbranded Amazon rebrands
                    (EK9716BD3 driver, GT911, N4R8 = 4 MB flash). PCLK on
                    GPIO0 like the 5.0; pairs with the 4 MB class.

            config CANFLIGHT_BOARD_WAVESHARE_7C
                bool "Waveshare ESP32-S3-Touch-LCD-7C (7 inch BOX, 800x480)"
                help
                    The boxed 7C: classic-7 panel family with G5/G6 data
                    moved to GPIO 9/8, I2C on 47/48 and the CH32V003-style
                    IO helper known from the 7B (TP_RST + backlight PWM).
                    ES8389 codec, battery, 32 MB flash / 16 MB PSRAM.
                    Dedicated build - the moved I2C bus defeats autodetect.

            config CANFLIGHT_BOARD_JC8012P4A1
                bool "Guition JC8012P4A1 (10.1 inch, ESP32-P4, 800x1280 MIPI-DSI)"
                help
                    Guition's 10.1 inch ESP32-P4 board: JD9365 MIPI-DSI panel
                    (native portrait, UI runs landscape 1280x800), Silead
                    GSL3680 touch, ESP32-C6 for Wi-Fi over SDIO on the P4
                    EV-board pins. Two panel revisions exist; pick the V2
                    option below for rear-case batch 2628 and newer.

            config CANFLIGHT_BOARD_ELECROW_P4_10
                bool "Elecrow CrowPanel Advanced 10.1 (ESP32-P4, 1024x600 MIPI-DSI)"
                help
                    Elecrow's 10.1 inch ESP32-P4 HMI: EK79007 MIPI-DSI panel
                    (native landscape 1024x600), GT911 touch on I2C 45/46,
                    backlight PWM on GPIO31, ESP32-C6 for Wi-Fi over SDIO
                    (V1.1/V1.2 wiring, see sdkconfig.elecrow10). Beta.

            config CANFLIGHT_BOARD_CROWPANEL_ADV70
                bool "Elecrow CrowPanel Advance 7.0 (DIS02170A V1.2+, 800x480, 16 MB)"
                help
                    The Advance-series 7 inch: N16R8 module (full 16 MB class),
                    RGB panel on its own sync pins (HSYNC 40 / VSYNC 41 / DE 42 /
                    PCLK 39), GT911 on I2C 15/16, backlight through the STC8
                    helper MCU at I2C 0x30. Covers hardware V1.2 through V1.5;
                    V1.0 (PCA9557 backlight) is not supported.

            config CANFLIGHT_BOARD_PANDATOUCH
                bool "BigTreeTech Panda Touch (5 inch, 800x480, battery)"
                help
                    BTT's Bambu-printer pendant: ESP32-S3 R8 with 16 MB
                    flash, a 5 inch 800x480 DE-only RGB panel (no HSYNC/
                    VSYNC wiring, reset on GPIO46), GT911 touch and a
                    battery. Pin map from BTT's own PandaTouch_IDF SDK.
                    Flashing replaces the stock Bambu-remote firmware
                    (restorable from BTT's published images).

            config CANFLIGHT_BOARD_SUNTON_8070
                bool "Sunton ESP32-8048S070 (7 inch, 800x480)"
                help
                    The 7 inch Sunton and its unbranded Amazon clones
                    (ST7262, GT911, 16 MB). Same resolution as the
                    Waveshare family but different wiring: DE/VSYNC are
                    swapped versus the Guition and the data bus is wired
                    in reverse order, so it needs its own build.

            config CANFLIGHT_BOARD_SUNTON_4827S043
                bool "Sunton ESP32-4827S043 (4.3 inch, 480x272)"
                help
                    The low-res 4.3 inch Sunton: same pins as the Guition
                    JC8048W550 but a 480x272 panel at 8 MHz pclk. The UI
                    renders its 800x480 design proportionally downscaled
                    (same physical layout as the Waveshare 4.3, lower
                    DPI). Dedicated build - the pins match the Guition,
                    so autodetect cannot tell them apart. This is the
                    capacitive (C, GT911) variant; resistive units use
                    the 4827S043R option below.

            config CANFLIGHT_BOARD_SUNTON_4827S043R
                bool "Sunton ESP32-4827S043R (4.3 inch, 480x272, resistive)"
                help
                    The resistive-touch (XPT2046 over SPI) variant of the
                    Sunton 4827S043. Same panel and pins as the C variant,
                    touch on the SD-card SPI bus (CLK 12 / MOSI 11 /
                    MISO 13, CS 38, IRQ 18).

            config CANFLIGHT_BOARD_CROWPANEL_50
                bool "Elecrow CrowPanel 5.0 (DIS07050H, 800x480, 4 MB flash)"
                help
                    Elecrow's 5 inch HMI: Guition-family RGB wiring with
                    PCLK moved to GPIO0 and GT911 on 19/20. The N4R8
                    module has only 4 MB flash, so this board pairs with
                    the 4 MB class (sdkconfig.board.4mb): single factory
                    app slot, no OTA (update via the web flasher), and a
                    logo-less asset set - logos are fetched on demand.
        endchoice

        config CANFLIGHT_JC10_PANEL_V2
            bool "JC8012P4A1: panel revision V2 (rear-case batch 2628+)"
            depends on CANFLIGHT_BOARD_JC8012P4A1
            default n
            help
                Same JD9365 driver chip, different glass: V2 wants its own
                init table, a 70 MHz pixel clock, 1.5 Gbps lanes and a 10
                line vsync back porch. Wrong choice shows horizontal lines
                or a blank panel. No runtime detection is known.

        config CANFLIGHT_JC10_ROT_270
            bool "JC8012P4A1: rotate the other way (270 instead of 90)"
            depends on CANFLIGHT_BOARD_JC8012P4A1
            default n

        config CANFLIGHT_JC10_TP_DIAG
            bool "JC8012P4A1: log raw and mapped touch points (test builds)"
            depends on CANFLIGHT_BOARD_JC8012P4A1
            default n

        config CANFLIGHT_TAB5_FORCE_ST7123
            bool "Tab5: force the ST7123 panel path on 0x55 units"
            default n
            help
                Diagnostic switch for the Tab5 panel-generation probe: treat
                every Sitronix unit (I2C 0x55) as ST7123, ignoring the touch
                firmware version register. Used by the tab5-b test build to
                tell a real ST7121 panel apart from a misdetected ST7123.

        config CANFLIGHT_WIFI_SSID
            string "Wi-Fi SSID"
            default ""

        config CANFLIGHT_WIFI_PASSWORD
            string "Wi-Fi password"
            default ""

        config CANFLIGHT_USE_FIXED_LOCATION
            bool "Use fixed location instead of IP geolocation"
            default n

        config CANFLIGHT_FIXED_LAT
            string "Fixed latitude (decimal degrees)"
            depends on CANFLIGHT_USE_FIXED_LOCATION
            default "52.2297"

        config CANFLIGHT_FIXED_LON
            string "Fixed longitude (decimal degrees)"
            depends on CANFLIGHT_USE_FIXED_LOCATION
            default "21.0122"

        config CANFLIGHT_RADIUS_NM
            int "Search radius (nautical miles)"
            default 54
            range 5 250
            help
                100 km is about 54 nm. airplanes.live caps at 250 nm.

        config CANFLIGHT_POLL_SECONDS
            int "Aircraft list poll interval (seconds)"
            default 8
            range 2 120
    endmenu
endmenu
```
